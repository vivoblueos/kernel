## kernel/arch/arm/arm64/Kconfig
```kconfig
menu "Aarch64 Configuration"

config KERNEL_PHYS_BASE
    hex "the physical base address of kernel space"
    default 0

config NUM_IRQS
    int

config PAGING
    bool

choice
    prompt "AArch64 virtual address size"
    default AARCH64_VA_BITS_39

config AARCH64_VA_BITS_39
    bool "39-bit (3-level page tables)"

config AARCH64_VA_BITS_48
    bool "48-bit (4-level page tables)"

endchoice

endmenu
```

## kernel/kernel/src/allocator/Kconfig
```kconfig
# Memory allocation algorithm configuration

choice
    prompt "Memory allocation algorithm"
    default ALLOCATOR_TLSF
    config ALLOCATOR_TLSF
        bool "TLSF algorithm"
    config ALLOCATOR_SLAB
        bool "SLAB algorithm (static)"
    config ALLOCATOR_SLAB_DYNAMIC
        bool "SLAB algorithm (dynamic, with page pool)"
    config ALLOCATOR_LLFF
        bool "LLFF algorithm"
endchoice

config ALLOCATOR
    string
    default "tlsf" if ALLOCATOR_TLSF
    default "slab" if ALLOCATOR_SLAB
    default "slab_dynamic" if ALLOCATOR_SLAB_DYNAMIC
    default "llff" if ALLOCATOR_LLFF

config SLAB_DEBUG
    bool "Enable SLAB allocator debug logging"
    default n
    depends on ALLOCATOR_SLAB || ALLOCATOR_SLAB_DYNAMIC
    help
      Enable debug logging for SLAB allocator operations including
      page allocation, deallocation, and pool management.

config SLAB_DYNAMIC_MAX_TOTAL_PAGES
    int "Max total pages in page pool"
    default 32
    depends on ALLOCATOR_SLAB_DYNAMIC

config ALLOCATOR_BUDDY
    bool "Use buddy allocator as dynamic slab backing allocator"
    depends on ALLOCATOR_SLAB_DYNAMIC
    default n
    help
        Use the buddy allocator to manage allocatable physical pages and
        serve as the backing allocator for dynamic slab.

        Dynamic slab obtains slab pages from buddy. Requests that cannot be
        served by a slab size class, including requests larger than 2048 bytes
        or requiring larger alignment, are forwarded to buddy.

        When disabled, dynamic slab uses TLSF as its backing allocator over
        the __heap_start to __heap_end range.

config BUDDY_MAX_ORDER
    int "Maximum buddy allocation order" if ALLOCATOR_BUDDY
    range 0 19
    default 11
    help
        Set the largest allocation order supported by the buddy allocator.
        An order-N allocation contains 2^N pages. With 4 KiB pages, the
        default order 11 supports allocations up to 8 MiB.
```

## kernel/kernel/src/devices/Kconfig
```kconfig
# General Device Configuration

config SPI_CORE
    default n
    bool "enable spi core"

config I2C_CORE
    default n
    bool "enable i2c core"

config SPI_FLASH_SECTOR_SIZE
    int "SPI flash logical sector size"
    default 512
    range 1 65535
    depends on ENABLE_BLOCK

config SPI_FLASH_PAGE_SIZE
    int "SPI flash page size"
    default 256
    range 1 65536
    depends on ENABLE_BLOCK

choice
    prompt "SPI flash erase size"
    default SPI_FLASH_ERASE_SIZE_4K
    depends on ENABLE_BLOCK

config SPI_FLASH_ERASE_SIZE_4K
    bool "4 KiB"

config SPI_FLASH_ERASE_SIZE_32K
    bool "32 KiB"

config SPI_FLASH_ERASE_SIZE_64K
    bool "64 KiB"

endchoice

config SPI_FLASH_ERASE_SIZE
    int
    default 4096 if SPI_FLASH_ERASE_SIZE_4K
    default 32768 if SPI_FLASH_ERASE_SIZE_32K
    default 65536 if SPI_FLASH_ERASE_SIZE_64K

config SPI_FLASH_MAX_CAPACITY
    int "Maximum SPI flash capacity using 3-byte addresses"
    default 16777216
    range 1 16777216
    depends on ENABLE_BLOCK

config SPI_FLASH_ERASE_CACHE_SLOTS
    int "SPI flash erase cache slots"
    default 2
    range 1 4
    depends on ENABLE_BLOCK

config SPI_FLASH_STATUS_POLL_INTERVAL_US
    int "SPI flash status polling interval in microseconds"
    default 20
    range 1 1000000
    depends on ENABLE_BLOCK

config SPI_FLASH_PAGE_PROGRAM_TIMEOUT_MS
    int "SPI flash page program timeout in milliseconds"
    default 5
    range 1 60000
    depends on ENABLE_BLOCK

config SPI_FLASH_SECTOR_ERASE_TIMEOUT_MS
    int "SPI flash sector erase timeout in milliseconds"
    default 500
    range 1 60000
    depends on ENABLE_BLOCK

config SPI_FLASH_BLOCK_ERASE_32K_TIMEOUT_MS
    int "SPI flash 32 KiB erase timeout in milliseconds"
    default 2000
    range 1 60000
    depends on ENABLE_BLOCK

config SPI_FLASH_BLOCK_ERASE_64K_TIMEOUT_MS
    int "SPI flash 64 KiB erase timeout in milliseconds"
    default 3000
    range 1 60000
    depends on ENABLE_BLOCK

config SPI_FLASH_CHIP_ERASE_TIMEOUT_MS
    int "SPI flash chip erase timeout in milliseconds"
    default 200000
    range 1 600000
    depends on ENABLE_BLOCK
```

## kernel/src/boards/seeed_xiao_esp32c3/Kconfig
```kconfig
# Soc specific configuration
# cortex-m
choice
    prompt "The cortex-m irq priority bits"
    default IRQ_PRIORITY_BITS_2
    help
      Choose between 2, 3 or 8 for the cortex-m irq priority bits.
    config IRQ_PRIORITY_BITS_2
        bool "2"
        help
          Set irq priority bits to 2.
    config IRQ_PRIORITY_BITS_3
        bool "3"
        help
          Set irq priority bits to 3.
    config IRQ_PRIORITY_BITS_8
        bool "8"
        help
          Set irq priority bits to 8.
endchoice

config LCD
    bool "Enable LCD device"
    default n
    help
      Enable LCD module

config FT6336U
    bool "Enable touch screen device"
    default n
    help
      Enable touch screen

config GPIO
    bool "Enable gpio device"
    default n
    help
      Enable gpio device

if LCD

  choice
    prompt "LCD controller"
    default ST7789

    config ST7789
        bool "Enable LCD ST7789"
        help
          Enable the ST7789 LCD controller.

    config ST7796
        bool "Enable LCD ST7796"
        help
          Enable the ST7796 LCD controller.
  endchoice

endif

config BME280
    bool "BME280 Sensor"
    default n
    help
      Enable BME280

config USE_EMBEDDED_HAL_V1
    bool "Impl embedded-hal-1.0.0 for driver"
    default y
    help
      Impl embedded-hal-1.0.0 for driver

config SOC_ESP32C3
    bool "Esp32c3"
    default y
    select RISCV
    select I2C_CORE

config NUM_IRQS
    default 31
```

## kernel/src/devices/Kconfig
```kconfig
# General Device Configuration

config SPI_CORE
    default n
    bool "enable spi core"

config I2C_CORE
    default n
    bool "enable i2c core"

config SPI_FLASH_SECTOR_SIZE
    int "SPI flash logical sector size"
    default 512
    range 1 65535
    depends on ENABLE_BLOCK

config SPI_FLASH_PAGE_SIZE
    int "SPI flash page size"
    default 256
    range 1 65536
    depends on ENABLE_BLOCK

choice
    prompt "SPI flash erase size"
    default SPI_FLASH_ERASE_SIZE_4K
    depends on ENABLE_BLOCK

config SPI_FLASH_ERASE_SIZE_4K
    bool "4 KiB"

config SPI_FLASH_ERASE_SIZE_32K
    bool "32 KiB"

config SPI_FLASH_ERASE_SIZE_64K
    bool "64 KiB"

endchoice

config SPI_FLASH_ERASE_SIZE
    int
    default 4096 if SPI_FLASH_ERASE_SIZE_4K
    default 32768 if SPI_FLASH_ERASE_SIZE_32K
    default 65536 if SPI_FLASH_ERASE_SIZE_64K

config SPI_FLASH_MAX_CAPACITY
    int "Maximum SPI flash capacity using 3-byte addresses"
    default 16777216
    range 1 16777216
    depends on ENABLE_BLOCK

config SPI_FLASH_ERASE_CACHE_SLOTS
    int "SPI flash erase cache slots"
    default 2
    range 1 4
    depends on ENABLE_BLOCK
```
