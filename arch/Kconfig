## arch/Kconfig
```kconfig
# Configuration corresponding to architecture 

config SRAM_SIZE
	int "SRAM Size in kB"
	help
	  The SRAM size in kB. 

config SRAM_BASE_ADDRESS
	hex "SRAM Base Address"
	help
	  The SRAM base address. 

config FLASH_BASE_ADDRESS
	hex "Flash Base Address"
	default 0x0
	help
	  The Flash base address.

config FLASH_SIZE
	int "Flash Size in kB"
	default 0
	help
	  The Flash size in kB.

config STACK_SIZE
	int "Stack Size in kB"
	help
	  Stack Size in kB used by Kernel.
```

## arch/arm/arm64/Kconfig
```kconfig
menu "Aarch64 Configuration"

config NUM_IRQS
    int

config KERNEL_VIRT_START
    hex "Kernel virtual address start"
    default 0xFFFFFF8000000000 if SOC_VIRT_AARCH64
    default 0x0
    help
      Base virtual address used by the kernel linear mapping on AArch64.

endmenu
```

## arch/arm/cortex_m/Kconfig
```kconfig
# Cortex-M Configuration

menu "Cortex-M Configuration"

config USE_MPU
    bool "MPU supports"
    default n

if USE_MPU
    choice
        prompt "Select MPU Type"
        help
          Choose one MPU type. For example, v7 for Cortex-M3, v8 for Cortex-M33
        config MPU_V8M
            bool "v8m mpu"
            help
              Select MPU_V8M
    endchoice 

    config MPU_STACK_GUARD
        bool "MPU stack guard supports"
        default n

endif

endmenu
```

## arch/riscv/Kconfig
```kconfig
# RISC-V Configuration

menu "RISCV Configuration"

config HAS_PLIC
    bool "PLIC supports"
    default n
    help
      Whether the platform supports the PLIC.

config HAS_CLIC
    bool "CLIC supports"
    default n
    help
      Whether the platform supports the CLIC.

config HAS_MIE
    bool "MIE supports"
    default n
    help
      Whether the platform supports the MIE.
      
endmenu
```

## kconfig/config/Kconfig
```kconfig
mainmenu "BlueOS Kernel"

# Use rsource for relative paths from current file location
# From kernel/kconfig/config/ to kernel/kernel/src/ is ../../kernel/src
# rsource allows using relative paths with environment variables
rsource "../../arch/Kconfig"
rsource "../../kernel/src/boards/$BOARD/Kconfig"
rsource "../../kernel/src/Kconfig"
rsource "../../kernel/src/allocator/Kconfig"
rsource "../../kernel/src/scheduler/Kconfig"
rsource "../../kernel/src/vfs/Kconfig"
rsource "../../kernel/src/net/Kconfig"

config UNITTEST_THREAD_NUM
    int "The num of thread used by uniitest."
    default 64
    help
        Set the number of thread used by unittest.
```

## kconfig/config/Kconfig.test
```kconfig
# Kconfig.test
#
# This Kconfig file is used to configure options for tests, including:
#   - Unit tests
#   - Integration tests
#   - Other test-related cases and infrastructure
#
config UNITTEST_THREAD_NUM
    int "The num of thread used by uniitest."
    default 64
    help
        Set the number of thread used by unittest.
```

## kconfig/config/bcm2711/debug/defconfig
```kconfig
CONFIG_ALIGN_SIZE=8
CONFIG_TICKS_PER_SECOND=100
CONFIG_SMP=y
# 4 cores for BCM2711, can't change, but for single core testing
CONFIG_NUM_CORES=1
CONFIG_THREAD_PRIORITY=y
# CONFIG_THREAD_PRIORITY_32 is not set
CONFIG_THREAD_PRIORITY_256=y
CONFIG_MAIN_THREAD_PRIORITY=100
CONFIG_THREAD_PRIORITY_MAX=256
CONFIG_SERIAL_RX_FIFO_SIZE=512
CONFIG_SERIAL_TX_FIFO_SIZE=512
CONFIG_ALLOCATOR_TLSF=y
# CONFIG_ALLOCATOR_SLAB is not set
# CONFIG_ALLOCATOR_LLFF is not set
# CONFIG_ALLOCATOR_BUDDY is not set
CONFIG_ALLOCATOR="tlsf"
CONFIG_SOFT_TIMER=y
CONFIG_ROBIN_SCHEDULER=y
CONFIG_ROBIN_SLICE=10
CONFIG_OVERFLOW_CHECK=y
CONFIG_STACK_HIGHWATER_CHECK=y
# CONFIG_DEBUGGING_SCHEDULER is not set
CONFIG_MAIN_THREAD_STACK_SIZE=12288
CONFIG_IDLE_THREAD_STACK_SIZE=2048
CONFIG_TIMER_THREAD_STACK_SIZE=2048
# CONFIG_FDT=y
# CONFIG_VIRTIO=y
CONFIG_PROCFS=y
# CONFIG_NETWORK_STACK_SIZE=32768

#
# smoltcp TCP/IP Stack Configuration
#
# CONFIG_SMOLTCP=y
# CONFIG_ASSEMBLER_MAX_SEGMENT_COUNT=4
# CONFIG_REASSEMBLY_BUFFER_COUNT=4
# CONFIG_REASSEMBLY_BUFFER_SIZE=1500
# CONFIG_FRAGMENTATION_BUFFER_SIZE=4096
# CONFIG_IFACE_MAX_ADDR_COUNT=8
# CONFIG_IFACE_MAX_MULTICAST_GROUP_COUNT=4
# CONFIG_IFACE_MAX_ROUTE_COUNT=2
# CONFIG_IFACE_MAX_SIXLOWPAN_ADDRESS_CONTEXT_COUNT=4
# CONFIG_IFACE_NEIGHBOR_CACHE_COUNT=8
# CONFIG_RPL_RELATIONS_BUFFER_COUNT=16
# CONFIG_RPL_PARENTS_BUFFER_COUNT=8
# CONFIG_IPV6_HBH_MAX_OPTIONS=4
# CONFIG_DNS_MAX_NAME_SIZE=255
# CONFIG_DNS_MAX_RESULT_COUNT=1
# CONFIG_DNS_MAX_SERVER_COUNT=1
# end of smoltcp TCP/IP Stack Configuration
```

## kconfig/config/gd32e507_eval/debug/defconfig
```kconfig
# CONFIG_IRQ_PRIORITY_BITS_2 is not set
# CONFIG_IRQ_PRIORITY_BITS_3 is not set
CONFIG_IRQ_PRIORITY_BITS_8=y
CONFIG_ALIGN_SIZE=8
CONFIG_TICKS_PER_SECOND=100
# CONFIG_SMP is not set
CONFIG_NUM_CORES=1
CONFIG_THREAD_PRIORITY=y
# CONFIG_THREAD_PRIORITY_32 is not set
CONFIG_THREAD_PRIORITY_256=y
CONFIG_MAIN_THREAD_PRIORITY=100
CONFIG_THREAD_PRIORITY_MAX=256
CONFIG_SERIAL_RX_FIFO_SIZE=512
CONFIG_SERIAL_TX_FIFO_SIZE=512
CONFIG_ALLOCATOR_TLSF=y
# CONFIG_ALLOCATOR_SLAB is not set
# CONFIG_ALLOCATOR_LLFF is not set
# CONFIG_ALLOCATOR_BUDDY is not set
CONFIG_ALLOCATOR="tlsf"
CONFIG_SOFT_TIMER=y
CONFIG_ROBIN_SCHEDULER=y
CONFIG_ROBIN_SLICE=10
CONFIG_OVERFLOW_CHECK=y
CONFIG_STACK_HIGHWATER_CHECK=y
#CONFIG_DEBUGGING_SCHEDULER=y
CONFIG_MAIN_THREAD_STACK_SIZE=12288
CONFIG_IDLE_THREAD_STACK_SIZE=2048
CONFIG_TIMER_THREAD_STACK_SIZE=2048
# CONFIG_FDT is not set
# CONFIG_VIRTIO is not set
CONFIG_PROCFS=y
CONFIG_ENABLE_NET=n

# linker script
CONFIG_SRAM_BASE_ADDRESS=0x20000000
CONFIG_SRAM_SIZE=128
CONFIG_STACK_SIZE=16
CONFIG_FLASH_BASE_ADDRESS=0x08000000
CONFIG_FLASH_SIZE=1024
```

## kconfig/config/gd32vw553_eval/release/defconfig
```kconfig
CONFIG_IRQ_PRIORITY_BITS_2=y
# CONFIG_IRQ_PRIORITY_BITS_3 is not set
# CONFIG_IRQ_PRIORITY_BITS_8 is not set
CONFIG_ALIGN_SIZE=8
CONFIG_TICKS_PER_SECOND=1000
CONFIG_SMP=n
CONFIG_NUM_CORES=1
CONFIG_USE_KERNEL_BOOT=y
CONFIG_ALLOCATOR_TLSF=y
# CONFIG_ALLOCATOR_SLAB is not set
# CONFIG_ALLOCATOR_LLFF is not set
# CONFIG_ALLOCATOR_BUDDY is not set
CONFIG_ALLOCATOR="tlsf"
# CONFIG_DEBUGGING_ALLOCATOR is not set

#
# Kernel Core Features
#
CONFIG_SOFT_TIMER=y
CONFIG_EVENT_FLAGS=y
CONFIG_ROBIN_SCHEDULER=y
CONFIG_ROBIN_SLICE=10
CONFIG_OVERFLOW_CHECK=y
CONFIG_STACK_HIGHWATER_CHECK=y
# CONFIG_DEBUGGING_SCHEDULER is not set
CONFIG_MAIN_THREAD_STACK_SIZE=12288
CONFIG_IDLE_THREAD_STACK_SIZE=2048
CONFIG_TIMER_THREAD_STACK_SIZE=2048
CONFIG_KERNEL_ASYNC=y
CONFIG_THREAD_PRIORITY=y
# CONFIG_THREAD_PRIORITY_32 is not set
CONFIG_THREAD_PRIORITY_256=y
CONFIG_THREAD_PRIORITY_MAX=256
CONFIG_MAIN_THREAD_PRIORITY=100
CONFIG_ASYNC_OUTPUT_THREAD_PRIORITY=255
# end of Kernel Core Features

CONFIG_ENABLE_SYSCALL=y
# CONFIG_FDT is not set
# CONFIG_VIRTIO is not set
CONFIG_SERIAL_RX_FIFO_SIZE=512
CONFIG_SERIAL_TX_FIFO_SIZE=512
CONFIG_ENABLE_VFS=y
CONFIG_PROCFS=y
CONFIG_ENABLE_NET=n
CONFIG_NETWORK_STACK_SIZE=24576

#
# smoltcp TCP/IP Stack Configuration
#
CONFIG_ASSEMBLER_MAX_SEGMENT_COUNT=4
CONFIG_REASSEMBLY_BUFFER_COUNT=4
CONFIG_REASSEMBLY_BUFFER_SIZE=1500
CONFIG_FRAGMENTATION_BUFFER_SIZE=4096
CONFIG_IFACE_MAX_ADDR_COUNT=8
CONFIG_IFACE_MAX_MULTICAST_GROUP_COUNT=4
CONFIG_IFACE_MAX_ROUTE_COUNT=2
CONFIG_IFACE_MAX_SIXLOWPAN_ADDRESS_CONTEXT_COUNT=4
CONFIG_IFACE_NEIGHBOR_CACHE_COUNT=8
CONFIG_RPL_RELATIONS_BUFFER_COUNT=16
CONFIG_RPL_PARENTS_BUFFER_COUNT=8
CONFIG_IPV6_HBH_MAX_OPTIONS=4
CONFIG_DNS_MAX_NAME_SIZE=255
CONFIG_DNS_MAX_RESULT_COUNT=1
CONFIG_DNS_MAX_SERVER_COUNT=1
# end of smoltcp TCP/IP Stack Configuration

#
# os adapter configuration
#
# CONFIG_RTTHREAD_ADAPTER is not set
# end of os adapter configuration
```

## kconfig/config/newlib_mps3_an547/Kconfig
```kconfig
# Soc specific configuration
# cortex-m
choice
    prompt "The cortex-m irq priority bits"
    default IRQ_PRIORITY_BITS_2
    help
      Choose between 2, 3 or 8 for the cortex-m irq priority bits.
    config IRQ_PRIORITY_BITS_2
        bool "2"
        help
          Set irq priority bits to 2.
    config IRQ_PRIORITY_BITS_3
        bool "3"
        help
          Set irq priority bits to 3.
    config IRQ_PRIORITY_BITS_8
        bool "8"
        help
          Set irq priority bits to 8.
endchoice
```

## kconfig/config/qemu_mps3_an547/release/defconfig
```kconfig
# CONFIG_IRQ_PRIORITY_BITS_2 is not set
# CONFIG_IRQ_PRIORITY_BITS_3 is not set
CONFIG_IRQ_PRIORITY_BITS_8=y
CONFIG_ALIGN_SIZE=8
CONFIG_TICKS_PER_SECOND=100
# CONFIG_SMP is not set
CONFIG_NUM_CORES=1
CONFIG_USE_KERNEL_BOOT=y
# CONFIG_ALLOCATOR_TLSF is not set
CONFIG_ALLOCATOR_SLAB=y
# CONFIG_ALLOCATOR_LLFF is not set
# CONFIG_ALLOCATOR_BUDDY is not set
CONFIG_ALLOCATOR="slab"
# CONFIG_DEBUGGING_ALLOCATOR is not set

#
# Kernel Core Features
#
CONFIG_SOFT_TIMER=y
CONFIG_EVENT_FLAGS=y
CONFIG_ROUND_ROBIN=y
CONFIG_ROBIN_SLICE=10
CONFIG_OVERFLOW_CHECK=y
CONFIG_STACK_HIGHWATER_CHECK=y
# CONFIG_DEBUGGING_SCHEDULER is not set
CONFIG_MAIN_THREAD_STACK_SIZE=12288
CONFIG_IDLE_THREAD_STACK_SIZE=2048
CONFIG_TIMER_THREAD_STACK_SIZE=2048
CONFIG_KERNEL_ASYNC=y
CONFIG_THREAD_PRIORITY=y
# CONFIG_THREAD_PRIORITY_32 is not set
CONFIG_THREAD_PRIORITY_256=y
CONFIG_THREAD_PRIORITY_MAX=256
CONFIG_MAIN_THREAD_PRIORITY=100
CONFIG_ASYNC_OUTPUT_THREAD_PRIORITY=255
# end of Kernel Core Features

CONFIG_ENABLE_SYSCALL=y
# CONFIG_FDT is not set
# CONFIG_VIRTIO is not set
CONFIG_SERIAL_RX_FIFO_SIZE=256
CONFIG_SERIAL_TX_FIFO_SIZE=256
# CONFIG_ENABLE_VFS is not set
# CONFIG_ENABLE_NET is not set

#
# os adapter configuration
#
CONFIG_CMSIS_RTOS1_ADAPTER=y
# CONFIG_CMSIS_RTOS2_ADAPTER is not set
# end of os adapter configuration

# linker script
CONFIG_SRAM_BASE_ADDRESS=0x21000000
CONFIG_SRAM_SIZE=4096
CONFIG_STACK_SIZE=4
CONFIG_FLASH_BASE_ADDRESS=0x01000000
CONFIG_FLASH_SIZE=2048
CONFIG_ROMSTART_RELOCATION=y
CONFIG_ROMSTART_ROM_ADDRESS=0x00000000
CONFIG_ROMSTART_ROM_SIZE=512
```

## kconfig/config/raspberry_pico2_cortexm/debug/defconfig
```kconfig
# CONFIG_IRQ_PRIORITY_BITS_2 is not set
# CONFIG_IRQ_PRIORITY_BITS_3 is not set
CONFIG_IRQ_PRIORITY_BITS_8=y
CONFIG_ALIGN_SIZE=8
CONFIG_TICKS_PER_SECOND=100
# CONFIG_SMP is not set
CONFIG_NUM_CORES=1
CONFIG_THREAD_PRIORITY=y
# CONFIG_THREAD_PRIORITY_32 is not set
CONFIG_THREAD_PRIORITY_256=y
CONFIG_MAIN_THREAD_PRIORITY=100
CONFIG_THREAD_PRIORITY_MAX=256
CONFIG_SERIAL_RX_FIFO_SIZE=512
CONFIG_SERIAL_TX_FIFO_SIZE=512
CONFIG_ALLOCATOR_TLSF=y
# CONFIG_ALLOCATOR_SLAB is not set
# CONFIG_ALLOCATOR_LLFF is not set
# CONFIG_ALLOCATOR_BUDDY is not set
CONFIG_ALLOCATOR="tlsf"
CONFIG_SOFT_TIMER=y
CONFIG_ROBIN_SCHEDULER=y
CONFIG_ROBIN_SLICE=10
CONFIG_OVERFLOW_CHECK=y
CONFIG_STACK_HIGHWATER_CHECK=y
#CONFIG_DEBUGGING_SCHEDULER=y
CONFIG_MAIN_THREAD_STACK_SIZE=12288
CONFIG_IDLE_THREAD_STACK_SIZE=2048
CONFIG_TIMER_THREAD_STACK_SIZE=2048
# CONFIG_FDT is not set
# CONFIG_VIRTIO is not set
CONFIG_PROCFS=y
CONFIG_NETWORK_STACK_SIZE=24576

#
# smoltcp TCP/IP Stack Configuration
#
# CONFIG_SMOLTCP=y
# CONFIG_ASSEMBLER_MAX_SEGMENT_COUNT=4
# CONFIG_REASSEMBLY_BUFFER_COUNT=4
# CONFIG_REASSEMBLY_BUFFER_SIZE=1500
# CONFIG_FRAGMENTATION_BUFFER_SIZE=4096
# CONFIG_IFACE_MAX_ADDR_COUNT=8
# CONFIG_IFACE_MAX_MULTICAST_GROUP_COUNT=4
# CONFIG_IFACE_MAX_ROUTE_COUNT=2
# CONFIG_IFACE_MAX_SIXLOWPAN_ADDRESS_CONTEXT_COUNT=4
# CONFIG_IFACE_NEIGHBOR_CACHE_COUNT=8
# CONFIG_RPL_RELATIONS_BUFFER_COUNT=16
# CONFIG_RPL_PARENTS_BUFFER_COUNT=8
# CONFIG_IPV6_HBH_MAX_OPTIONS=4
# CONFIG_DNS_MAX_NAME_SIZE=255
# CONFIG_DNS_MAX_RESULT_COUNT=1
# CONFIG_DNS_MAX_SERVER_COUNT=1
# end of smoltcp TCP/IP Stack Configuration

# linker script
CONFIG_SRAM_BASE_ADDRESS=0x20000000
CONFIG_SRAM_SIZE=512
CONFIG_STACK_SIZE=16
CONFIG_FLASH_BASE_ADDRESS=0x10000000
CONFIG_FLASH_SIZE=4096
```

## kconfig/config/rk3568/release/defconfig
```kconfig
CONFIG_ALIGN_SIZE=8
CONFIG_TICKS_PER_SECOND=100
CONFIG_SMP=y
CONFIG_NUM_CORES=4
CONFIG_USE_KERNEL_BOOT=y
CONFIG_ALLOCATOR_TLSF=y
# CONFIG_ALLOCATOR_SLAB is not set
# CONFIG_ALLOCATOR_LLFF is not set
# CONFIG_ALLOCATOR_BUDDY is not set
CONFIG_ALLOCATOR="tlsf"
# CONFIG_DEBUGGING_ALLOCATOR is not set

#
# Kernel Core Features
#
CONFIG_SOFT_TIMER=y
# CONFIG_EVENT_FLAGS is not set
CONFIG_ROBIN_SCHEDULER=y
CONFIG_ROBIN_SLICE=10
CONFIG_OVERFLOW_CHECK=y
CONFIG_STACK_HIGHWATER_CHECK=y
# CONFIG_DEBUGGING_SCHEDULER is not set
CONFIG_MAIN_THREAD_STACK_SIZE=12288
CONFIG_IDLE_THREAD_STACK_SIZE=2048
CONFIG_TIMER_THREAD_STACK_SIZE=2048
CONFIG_KERNEL_ASYNC=y
CONFIG_THREAD_PRIORITY=y
# CONFIG_THREAD_PRIORITY_32 is not set
CONFIG_THREAD_PRIORITY_256=y
CONFIG_THREAD_PRIORITY_MAX=256
CONFIG_MAIN_THREAD_PRIORITY=100
CONFIG_ASYNC_OUTPUT_THREAD_PRIORITY=255
# end of Kernel Core Features

CONFIG_ENABLE_SYSCALL=y
# CONFIG_FDT is not set
# CONFIG_VIRTIO is not set
CONFIG_SERIAL_RX_FIFO_SIZE=256
CONFIG_SERIAL_TX_FIFO_SIZE=256
CONFIG_ENABLE_VFS=y
CONFIG_PROCFS=y
# CONFIG_ENABLE_NET is not set

#
# os adapter configuration
#
# CONFIG_RTTHREAD_ADAPTER is not set
# end of os adapter configuration
```

## kconfig/config/seeed_xiao_esp32c3/release/defconfig
```kconfig
# CONFIG_IRQ_PRIORITY_BITS_3 is not set
CONFIG_IRQ_PRIORITY_BITS_2=y
CONFIG_ALIGN_SIZE=8
CONFIG_TICKS_PER_SECOND=100
CONFIG_SMP=n
CONFIG_NUM_CORES=1
CONFIG_ALLOCATOR_TLSF=y
CONFIG_ALLOCATOR="tlsf"
CONFIG_USE_KERNEL_BOOT=y
#
# Kernel Core Features
#
CONFIG_SOFT_TIMER=y
CONFIG_EVENT_FLAGS=y
CONFIG_ROBIN_SCHEDULER=y
CONFIG_ROBIN_SLICE=10
CONFIG_OVERFLOW_CHECK=y
CONFIG_STACK_HIGHWATER_CHECK=y
CONFIG_MAIN_THREAD_STACK_SIZE=12288
CONFIG_IDLE_THREAD_STACK_SIZE=2048
CONFIG_TIMER_THREAD_STACK_SIZE=2048
CONFIG_THREAD_PRIORITY=y
CONFIG_THREAD_PRIORITY_32=y
CONFIG_THREAD_PRIORITY_MAX=32
CONFIG_MAIN_THREAD_PRIORITY=32

CONFIG_ENABLE_SYSCALL=y
# CONFIG_FDT is not set
# CONFIG_VIRTIO is not set
CONFIG_SERIAL_RX_FIFO_SIZE=256
CONFIG_SERIAL_TX_FIFO_SIZE=256
CONFIG_ENABLE_VFS=y
CONFIG_ENABLE_NET=n
CONFIG_PROCFS=n
```

## kernel/arch/arm/cortex_m/Kconfig
```kconfig
# Cortex-M Configuration

menu "Cortex-M Configuration"

config NUM_IRQS
    int

config USE_MPU
    bool "MPU supports"
    default n

if USE_MPU
    choice
        prompt "Select MPU Type"
        help
          Choose one MPU type. For example, v7 for Cortex-M3, v8 for Cortex-M33
        config MPU_V8M
            bool "v8m mpu"
            help
              Select MPU_V8M
    endchoice 

    config MPU_STACK_GUARD
        bool "MPU stack guard supports"
        default n

if MPU_STACK_GUARD
    config STACK_GUARD_ALIGN_AND_SIZE
        hex "Stack guard align and size"
        default 0x40 if MPU_V8M
        help
          The align and size of Stack guard
endif

endif

endmenu
```

## kernel/kernel/src/vfs/Kconfig
```kconfig
# Virtual File System Configuration

config ENABLE_VFS
    bool "Enable Virtual File System"
    default y
    help
      Enable virtual file system support. When enabled, vfs will be available.

config PROCFS
    depends on ENABLE_VFS
    default n
    bool "Enable proc file system"
```
