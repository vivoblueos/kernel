## kernel/src/Kconfig
```kconfig
# General Kernel Configuration

config ALIGN_SIZE
    default 8
    int "Alignment size for CPU architecture data access"

config TICKS_PER_SECOND
    default 100
    int "Tick frequency, Hz"

config SMP
    default n
    bool "Enable Symmetric multiprocessing"

config NUM_CORES
    default 4 if SMP
    default 1 if !SMP
    int "Number of CPUs"

config USE_KERNEL_BOOT
    default y
    bool "Use kernel default boot"

config ENABLE_SYSCALL
    default y
    bool "Enable support for syscall"

config FDT
    default n
    bool "Enable Flat Device Tree"

config VIRTIO
    default n
    bool "Enable VirtIO"

config SERIAL_RX_FIFO_SIZE
    default 256
    int "The serial rx fifo size"

config SERIAL_TX_FIFO_SIZE
    default 256
    int "The serial tx fifo size"

# os adapter configuration
menu "os adapter configuration"
    choice
        prompt "RTOS Adapter Selection"
        optional
        help
          Select which RTOS adapter to use. Only one can be selected.

    config CMSIS_RTOS1_ADAPTER
        bool "CMSIS RTOS1 Adapter"
        help
          os adapter for CMSIS RTOS1

    config CMSIS_RTOS2_ADAPTER
        bool "CMSIS RTOS2 Adapter"
        help
          os adapter for CMSIS RTOS2

    endchoice
endmenu # os adapter configuration
```

## kernel/src/allocator/Kconfig
```kconfig
# Memory allocation algorithm configuration

choice
    prompt "Memory allocation algorithm"
    default ALLOCATOR_TLSF
    config ALLOCATOR_TLSF
        bool "TLSF algorithm"
    config ALLOCATOR_SLAB
        bool "SLAB algorithm (static)"
    config ALLOCATOR_SLAB_DYNAMIC
        bool "SLAB algorithm (dynamic, with page pool)"
    config ALLOCATOR_LLFF
        bool "LLFF algorithm"
endchoice

config ALLOCATOR
    string
    default "tlsf" if ALLOCATOR_TLSF
    default "slab" if ALLOCATOR_SLAB
    default "slab_dynamic" if ALLOCATOR_SLAB_DYNAMIC
    default "llff" if ALLOCATOR_LLFF

config SLAB_DEBUG
    bool "Enable SLAB allocator debug logging"
    default n
    depends on ALLOCATOR_SLAB || ALLOCATOR_SLAB_DYNAMIC
    help
      Enable debug logging for SLAB allocator operations including
      page allocation, deallocation, and pool management.

config SLAB_DYNAMIC_MAX_TOTAL_PAGES
    int "Max total pages in page pool"
    default 32
    depends on ALLOCATOR_SLAB_DYNAMIC

config ALLOCATOR_BUDDY
    bool "Enable buddy allocator as physical page manager"
    default n
    help
        Enable the buddy allocator to manage all physical memory pages.
        This can coexist with TLSF/SLAB/LLFF, which remain the selected
        heap allocator for small allocations.
        When enabled, slab allocator operates on top of buddy-allocated
        page pools; >= PAGE_SIZE allocations go directly to buddy;
        tlsf/llff keep their original __heap_start~__heap_end path.
        When disabled, the kernel falls back to direct heap management.
```

## kernel/src/boards/gd32vw553_eval/Kconfig
```kconfig
config SOC_GD32VW553
    bool "Gd32vw553"
    default y
    select RISCV
    select HAS_MIE
    select HAS_PLIC
```

## kernel/src/boards/qemu_virt64_aarch64/Kconfig
```kconfig
# Board specific configuration for qemu_virt64_aarch64

config SOC_VIRT_AARCH64
    bool "Virt Aarch64"
    default y
    select AARCH64

config NUM_IRQS
    default 220
```

## kernel/src/boards/rk3568/Kconfig
```kconfig
# Board specific configuration for rk3568

config SOC_RK3568
    bool "rk3568"
    default y
    select AARCH64

config NUM_IRQS
	default 240
```

## kernel/src/coredump/Kconfig
```kconfig
config ENABLE_COREDUMP
    bool "Enable ELF coredump on fatal faults"
    default n
    help
      Generate an ELF ET_CORE coredump when the kernel hits a fatal
      exception or panic. Output goes to the configured backend
      (file, logging, or memory).

config COREDUMP_BUF_SIZE
    int "Coredump ELF buffer size in bytes"
    default 65536 if CORTEX_M
    default 262144 if !CORTEX_M && 32BIT
    default 4194304
    depends on ENABLE_COREDUMP
    help
      Size of the static buffer used to construct the ELF coredump
      in memory before output. Cortex-M devices with limited RAM
      should use a smaller value (e.g. 65536). 64-bit platforms
      with large BSS segments may need 4 MB.

config COREDUMP_MEM_BACKEND
    bool "Store coredump in a static memory buffer"
    default n
    depends on ENABLE_COREDUMP
    help
      Store the coredump ELF in a static buffer (COREDUMP_STORAGE)
      for post-mortem retrieval by a subsequent boot or debugger.
      The buffer size matches COREDUMP_BUF_SIZE.
      If disabled, the coredump goes to FileBackend (when VFS is
      available) or LoggingBackend (serial output).
```

## kernel/src/net/Kconfig
```kconfig
# Network Stack Configuration

config ENABLE_NET
    bool "Enable Network Stack"
    default y
    help
      Enable network stack support. When enabled, smoltcp TCP/IP stack will be available.

config NETWORK_STACK_SIZE
    depends on ENABLE_NET
    default 24576
    int "The stack size of network stack thread"

# smoltcp IP Stack Configuration , default and range from smoltcp:gen_config.py
menu "smoltcp TCP/IP Stack Configuration"
    depends on ENABLE_NET

config ASSEMBLER_MAX_SEGMENT_COUNT
    int "Maximum non-contiguous segments count for reassembly"
    default 4
    range 1 32
    help
      Maximum number of non-contiguous segments the assembler can hold. Used for both packet reassembly and TCP stream reassembly.

config REASSEMBLY_BUFFER_COUNT
    int "Number of reassembly buffers"
    default 4
    range 1 32
    help
      Number of reassembly buffers, i.e how many different incoming packets can be reassembled at the same time.

config REASSEMBLY_BUFFER_SIZE
    int "Reassembly buffer size for incoming packets"
    default 1500
    range 256 65536
    help
      Size of the buffer used for reassembling (de-fragmenting) incoming packets. If the reassembled packet is larger than this setting, it will be dropped instead of reassembled.

config FRAGMENTATION_BUFFER_SIZE
    int "Fragmentation buffer size for outgoing packets"
    default 4096
    range 256 65536
    help
      Size of the buffer used for fragmenting outgoing packets larger than the MTU. Packets larger than this setting will be dropped instead of fragmented.

config IFACE_MAX_ADDR_COUNT
    int "Maximum IP addresses per interface"
    default 8
    range 1 8
    help
      Max amount of IP addresses that can be assigned to one interface (counting both IPv4 and IPv6 addresses).

config IFACE_MAX_MULTICAST_GROUP_COUNT
    int "Maximum multicast groups per interface"
    default 4
    range 1 1024
    help
      Max amount of multicast groups that can be joined by one interface.

config IFACE_MAX_ROUTE_COUNT
    int "Maximum routing table entries"
    default 2
    range 1 1024
    help
      Max amount of routes that can be added to one interface. Includes the default route. Includes both IPv4 and IPv6.

config IFACE_MAX_SIXLOWPAN_ADDRESS_CONTEXT_COUNT
    int "Maximum 6LoWPAN address contexts per interface"
    default 4
    range 1 1024
    help
      Max amount of 6LoWPAN address contexts that can be assigned to one interface.

config IFACE_NEIGHBOR_CACHE_COUNT
    int "Neighbor(ARP) cache entries count"
    default 8
    range 1 1024
    help
      Amount of "IP address -> hardware address" entries the neighbor cache (also known as the "ARP cache" or the "ARP table") holds.

config RPL_RELATIONS_BUFFER_COUNT
    int "Maximum RPL routing neighbor relations"
    default 16
    range 1 128
    help
      Maximum RPL routing neighbor relations

config RPL_PARENTS_BUFFER_COUNT
    int "Maximum RPL parent nodes in DODAG"
    default 8
    range 2 32
    help
      Maximum RPL parent nodes in DODAG

config IPV6_HBH_MAX_OPTIONS
    int "IPv6 Hop-by-Hop options"
    default 4
    range 1 32
    help
      The maximum amount of parsed options the IPv6 Hop-by-Hop header can hold.

config DNS_MAX_NAME_SIZE
    int "Maximum DNS name length"
    default 255
    range 64 255
    help
      Maximum length of DNS names that can be queried. (RFC 1035)

config DNS_MAX_RESULT_COUNT
    int "Maximum DNS results per query"
    default 1
    range 1 32
    help
      Maximum amount of address results for a given DNS query that will be kept. For example, if this is set to 2 and the queried name has 4 `A` records, only the first 2 will be returned.

config DNS_MAX_SERVER_COUNT
    int "Maximum DNS servers"
    default 1
    range 1 32
    help
      Maximum amount of DNS servers that can be configured in one DNS socket.

endmenu # SMOLTCP
```

## kernel/src/scheduler/Kconfig
```kconfig
# Kernel Core Features Configuration

menu "Kernel Core Features"

config SOFT_TIMER
    default y
    bool "Enable soft timer"

config EVENT_FLAGS
    default y if CMSIS_RTOS1_ADAPTER || CMSIS_RTOS2_ADAPTER
    default n
    bool "Enable event flags"

config ROUND_ROBIN
    default y
    bool "Enable robin scheduler"

config ROBIN_SLICE
    default 10
    int "The tick slice of robin scheduler"
    depends on ROUND_ROBIN

config OVERFLOW_CHECK
    default y
    bool "Using stack overflow checking"

config STACK_HIGHWATER_CHECK
    default y
    bool "Enable stack overflow checking"

config DEBUGGING_SCHEDULER
    default n
    bool "Enable debugging of scheduler"

config MAIN_THREAD_STACK_SIZE
    default 12288
    int "Set main thread stack size"

config IDLE_THREAD_STACK_SIZE
    default 2048
    int "The stack size of idle thread"

config TIMER_THREAD_STACK_SIZE
    default 2048
    int "The stack size of timer thread"

config KERNEL_ASYNC
    default y
    bool "Enable async kernel"

config THREAD_PRIORITY
    default y 
    bool "use thread stack priority"

choice
    prompt "Thread priority range"
    default THREAD_PRIORITY_256
    depends on THREAD_PRIORITY
    help
      Choose the maximum thread priority value.
    config THREAD_PRIORITY_32
        bool "32"
        help
          Set maximum thread priority to 32.
    config THREAD_PRIORITY_256
        bool "256"
        help
          Set maximum thread priority to 256.
endchoice

config THREAD_PRIORITY_MAX
    default 256 if THREAD_PRIORITY_256
    default 32 if THREAD_PRIORITY_32
    depends on THREAD_PRIORITY
    int "Maximum thread priority value"

config MAIN_THREAD_PRIORITY
    depends on THREAD_PRIORITY
    default 100 if THREAD_PRIORITY_256
    default 10 if THREAD_PRIORITY_32
    int "Set main thread priority"
    range 1 THREAD_PRIORITY_MAX

config ASYNC_OUTPUT_THREAD_PRIORITY
    depends on KERNEL_ASYNC
    depends on THREAD_PRIORITY
    default 255 if THREAD_PRIORITY_256
    default 31 if THREAD_PRIORITY_32
    int "The async output thread stack priority"
    range 1 THREAD_PRIORITY_MAX
    help
      Set the priority for the async output thread. Maximum value depends on THREAD_PRIORITY_MAX.

endmenu
```
